## Documentation/devicetree/bindings/ata/brcmstb-sata.txt
```
* Broadcom STB AHCI SATA Controller (brcmstb-ahci)

Required properties:
- compatible: compatible list, must contain "generic-ahci"
- reg: specifies the base physical address and size of the registers
- interrupts: The interrupt number to the cpu. The interrupt specifier format
  depends on the interrupt controller.
- phys: Must contain exactly one entry as specified in phy-bindings.txt
- phy-names: Must be "sata-phy"

Example:
	ahci0: ahci@181000 {
		compatible = "brcm,brcmstb-ahci", "generic-ahci";
		reg = <0x181000 0x10000>;
		#address-cells = <1>;
		#size-cells = <0>;
		interrupt-parent = <&periph_intc>;
		interrupts = <86>;

		sata0: sata-port@0 {
			reg = <0>;
			phys = <&sata_phy0 0>;
			status = "disabled";
		};

		sata1: sata-port@1 {
			reg = <1>;
			phys = <&sata_phy0 1>;
			status = "disabled";
		};
	};
```

## Documentation/devicetree/bindings/clock/brcm,brcmstb-cpu-clk-div.txt
```
The CPU divider node serves as the sole clock for the CPU complex. It supports
power-of-2 clock division, with a divider of "1" as the default highest-speed
setting.

Required properties:
- compatible: shall be "brcm,brcmstb-cpu-clk-div"
- reg: address and width of the divider configuration register
- #clock-cells: shall be set to 0
- clocks: phandle of clock provider which provides the source clock
          (this would typically be a "fixed-clock" type PLL)

Optional properties:
- clock-names: the clock may be named

Example:
	cpuclkdiv: clock-controller@f03e257c {
		compatible = "brcm,brcmstb-cpu-clk-div";
		reg = <0xf03e257c 0x4>;
		#clock-cells = <0>;
		clocks = <&cpupll>;
		clock-names = "cpupll";
	};
```

## Documentation/devicetree/bindings/mailbox/brcm,brcmstb-mbox.yaml
```yaml
# SPDX-License-Identifier: (GPL-2.0 OR BSD-2-Clause)
%YAML 1.2
---
$schema: "http://devicetree.org/meta-schemas/core.yaml#"
$id: http://devicetree.org/schemas/mailbox/brcm,brcmstb-mbox.yaml#

title: Broadcom STB mailbox driver bindings

maintainers:
  - Jim Quinlan <james.quinlan@broadcom.com>

properties:
  compatible:
    enum:
      - brcm,brcmstb-mbox

  interrupts:
    items:
      - description: a2p return interrupt, indicates SCMI msg completion.

  "#mbox-cells":
    const: 1

required:
  - compatible
  - interrupts
  - "#mbox-cells"

additionalProperties: false

examples:
  - |
    #include <dt-bindings/interrupt-controller/arm-gic.h>
    mailbox {
      compatible = "brcm,brcmstb-mailbox";
      #mbox-cells = <1>;
      interrupts = <GIC_SPI 0xc6 IRQ_TYPE_LEVEL_HIGH>;
    };
...
```

## Documentation/devicetree/bindings/mips/brcm/soc.txt
```
* Broadcom cable/DSL/settop platforms

Required properties:

- compatible: "brcm,bcm3368", "brcm,bcm3384", "brcm,bcm33843"
              "brcm,bcm3384-viper", "brcm,bcm33843-viper"
              "brcm,bcm6328", "brcm,bcm6358", "brcm,bcm6362", "brcm,bcm6368",
              "brcm,bcm63168", "brcm,bcm63268",
              "brcm,bcm7125", "brcm,bcm7346", "brcm,bcm7358", "brcm,bcm7360",
              "brcm,bcm7362", "brcm,bcm7420", "brcm,bcm7425"

The experimental -viper variants are for running Linux on the 3384's
BMIPS4355 cable modem CPU instead of the BMIPS5000 application processor.

Power management
----------------

For power management (particularly, S2/S3/S5 system suspend), the following SoC
components are needed:

= Always-On control block (AON CTRL)

This hardware provides control registers for the "always-on" (even in low-power
modes) hardware, such as the Power Management State Machine (PMSM).

Required properties:
- compatible     : should contain "brcm,brcmstb-aon-ctrl"
- reg            : the register start and length for the AON CTRL block

Example:

aon-ctrl@410000 {
	compatible = "brcm,brcmstb-aon-ctrl";
	reg = <0x410000 0x400>;
};

= Memory controllers

A Broadcom STB SoC typically has a number of independent memory controllers,
each of which may have several associated hardware blocks, which are versioned
independently (control registers, DDR PHYs, etc.). One might consider
describing these controllers as a parent "memory controllers" block, which
contains N sub-nodes (one for each controller in the system), each of which is
associated with a number of hardware register resources (e.g., its PHY). See
the example device tree snippet below.

== MEMC (MEMory Controller)

Represents a single memory controller instance.

Required properties:
- compatible     : should contain "brcm,brcmstb-memc" and "simple-bus"

Should contain subnodes for any of the following relevant hardware resources:

== DDR PHY control

Control registers for this memory controller's DDR PHY.

Required properties:
- compatible     : should contain one of these
	"brcm,brcmstb-ddr-phy-v64.5"
	"brcm,brcmstb-ddr-phy"

- reg            : the DDR PHY register range

== MEMC Arbiter

The memory controller arbiter is responsible for memory clients allocation
(bandwidth, priorities etc.) and needs to have its contents restored during
deep sleep states (S3).

Required properties:

- compatible	: should contain one of these
	"brcm,brcmstb-memc-arb-v10.0.0.0"
	"brcm,brcmstb-memc-arb"

- reg		: the DDR Arbiter register range

== Timers

The Broadcom STB chips contain a timer block with several general purpose
timers that can be used.

Required properties:

- compatible	: should contain "brcm,brcmstb-timers"
- reg		: the timers register range
```

## Documentation/devicetree/bindings/mmc/brcm,sdhci-brcmstb.txt
```
Broadcom STB SDHCI controller

This file documents differences between the core properties described
by mmc.txt and the properties that represent the brcmstb SDHCI controller.

Required properties:
- compatible : Should be "brcm,sdhci-brcmstb".
- clocks : The clock feeding the SDHCI controller.

Example:

sdhci0: sdhci@410000 {
	compatible = "brcm,sdhci-brcmstb";
	reg = <0x410000 0x100>, <0x410100 0x100>;
	reg-names = "host", "cfg";
	interrupt-parent = <&periph_intc>;
	interrupts = <82>;
};
```

## Documentation/devicetree/bindings/mmc/sdhci-brcmstb.txt
```
* Broadcom STB SDHCI controller (sdhci-brcmstb)

Required properties:
- compatible: "brcm,brcmstb-sdhci"
- reg: Base address and length of the register in the following order:
	- Host controller register map (required)
	- SD configuration register map (required)
- interrupts: The interrupt number to the cpu. The interrupt specifier format
  depends on the interrupt controller.

Example:
	sdhci0: sdhci@410000 {
		compatible = "brcm,brcmstb-sdhci";
		reg = <0x410000 0x100>, <0x410100 0x100>;
		interrupt-parent = <&periph_intc>;
		interrupts = <82>;
		bus-width = <4>;
		max-frequency = <50000000>;
		status = "disabled";
	};
```

## Documentation/devicetree/bindings/mtd/brcmstb-nand.txt
```
* Broadcom STB NAND Controller (brcmstb-nand)

Required properties:
- compatible: "brcm,brcmstb-nand"
- reg: Base address and length of the register in the following order:
	- Host controller register map (required)
	- L1 interrupt register map (required)
- interrupts: The interrupt number to the cpu. The interrupt specifier format
  depends on the interrupt controller.
- nand-bus-width: see nand.txt
- nand-ecc-mode: see nand.txt
- nand-cs: specifies the chip select line

Example:
	nand0: nand@412800 {
		compatible = "brcm,brcmstb-nand";
		reg = <0x412800 0x400>, <0x411000 0x18>;
		interrupt-parent = <&periph_intc>;
		interrupts = <30>;
		nand-ecc-mode = "hw";
		nand-bus-width = <8>;
		nand-on-flash-bbt;
		nand-cs = <0>;
		status = "disabled";
	};
```

## Documentation/devicetree/bindings/pci/brcm,brcmstb-pcie.txt
```
Broadcom STB PCIe Host Controller Device Tree Bindings

This document describes the binding of the PCIe Root Complex hardware found in
Broadcom Set Top Box System-on-Chips such as BCM7425 (MIPS), BCM7435 (MIPS) and
BCM7445 (ARMv7).

Required properties:
- compatible: must be one of: "brcm,bcm7425-pcie"
			      "brcm,bcm7435-pcie"
			      "brcm,bcm7445-pcie"

- reg: specifies the physical base address of the controller registers and
  its length

- interrupt-parent: must be a reference (phandle) to the parent interrupt
  controller in the system (7038-l1-intc on MIPS, GIC on ARM/ARM64)

- interrrupts: first interrupt must be the Level 1 interrupt number corresponding
  to the main PCIe RC interrupt, second interrupt must be the MSI interrupt
  See the interrupt-parent documentation for the number of cells and their meaning:
  MIPS: Documentation/devicetree/bindings/interrupt-controller/brcm,bcm7038-l1-intc.txt
  ARM/ARM64: Documentation/devicetree/bindings/interrupt-controller/arm,gic.txt

- interrupt-names: must be "pcie", and if present "msi"

- interrupt-map: see pci.txt

- interrupt-map-mask: see pci.txt

- #address-cells: must be set to <3>, see pci.txt

- #size-cells: must be set to <2>, see pci.txt

- ranges: ranges for the PCI outbound windows, no I/O or prefetchable windows
  must be specified here, only non-prefetchable. 32-bits windows or 64-bits
  windows are allowed based on the host processor's capabilities (ARM w/ LPAE,
  ARM64).

- #interrupt-cells: set to <1>, see pci.txt

- brcm,log2-scb-sizes: log2 size of the SCB window that is mapped to PCIe space
  there must be exactly one value per memory controller present in the system
  (ranges from 1 to 3)

Optional properties:

- msi-controller: indicates that this is a MSI controller node (when supported)

- clocks: phandle to the functional clock that feeds into the PCIe RC block

- clock-names: the name(s) of the clocks specified in 'clocks'.  Note
  that if the 'clocks' property is given, 'clock-names' is mandatory,
  and the name of the clock is expected to be "pcie".

- brcm,ssc: boolean that indicates usage of spread-spectrum clocking

- brcm,gen: integer that indicates desired forced generation of link: 1 => 2.5
  Gbps, 2 => 5.0 Gbps, 3 => 8.0 Gbps. Will override the auto-negotation if
  specified.

- <*>-supply: see Documentation/devicetree/bindings/regulator/regulator.txt

- <*>-supply-names: see Documentation/devicetree/bindings/regulator/regulator.txt

Example Node:

This example assumes that the top-level #address-cells = <2> and #size-cells =
<2>, e.g: ARM LPAE configuration.

	pcie0: pcie-controller@f0460000 {
		reg = <0x0 0xf0460000 0x0 0x9310>;
		interrupts = <0x0 0x33 0x4>, <0x0 0x34, 0x4>;
		interrupt-names = "pcie", "msi";
		compatible = "brcm,bcm7445-pcie";
		#address-cells = <3>;
		#size-cells = <2>;

		/* Two non-prefetchable 32-bits memory space, each of 128MB
 		 * with the following mapping:
		 * PCIe address		=> CPU physical address space
		 * 0x00_0000_0000	=> 0x00_C000_0000
		 * 0x00_0800_0000	=> 0x00_C800_0000
		 */
		ranges = <0x02000000 0x00000000 0x00000000 0x00000000 0xc0000000 0x00000000 0x08000000>,
			 <0x02000000 0x00000000 0x08000000 0x00000000 0xc8000000 0x00000000 0x08000000>;
		#interrupt-cells = <1>;
		interrupt-map-mask = <0xf800 0 0 7>;
		interrupt-map = <0 0 0 1 &intc 47 3
				 0 0 0 2 &intc 48 3
				 0 0 0 3 &intc 49 3
				 0 0 0 4 &intc 50 3>;
		clocks = <&pcie0>;
		clock-names = "pcie";
		brcm,ssc;
		brcm,log2-scb-sizes = <0x1e 0x1e 0x1e>;
		vreg-wifi-pwr-supply-names = "vreg-wifi-pwr";
		vreg-wifi-pwr-supply = <&vreg-wifi-pwr>;
	};
```

## Documentation/devicetree/bindings/phy/brcm,brcmstb-sata-phy.txt
```
* Broadcom SATA3 PHY for STB

Required properties:
- compatible: should be one or more of
     "brcm,bcm7445-sata-phy"
     "brcm,phy-sata3"
- address-cells: should be 1
- size-cells: should be 0
- phy-cells: generic PHY binding; must be 1
- reg: register ranges for the PHY PCB interface, and for the PHY port control
     registers found in the SATA_TOP_CTRL block (i.e., PHY_CTRL 1/2/3/4)
- reg-names: should be "phy" and "port-ctrl"

Sub-nodes:
  Each port's PHY should be represented as a sub-node.

Sub-nodes required properties:
- reg: the PHY number
Optional:
- brcm,enable-ssc: use spread spectrum clocking (SSC) on this port


Example:

	sata-phy@f0458100 {
		compatible = "brcm,bcm7445-sata-phy", "brcm,phy-sata3";
		reg = <0xf0458100 0x1e00>, <0xf045804c 0x10>;
		reg-names = "phy", "port-ctrl";
		#phy-cells = <1>;
		#address-cells = <1>;
		#size-cells = <0>;

		sata-phy@0 {
			reg = <0>;
		};

		sata-phy@1 {
			reg = <1>;
		};
	};
```

## Documentation/devicetree/bindings/phy/brcm,brcmstb-usb-phy.txt
```
Broadcom STB USB PHY

Required properties:
 - compatible: brcm,brcmstb-usb-phy
 - reg: two offset and length pairs. The second pair specifies the
        USB 3.0 related registers and is only required for PHYs
        that support USB 3.0
 - #phy-cells: Shall be 1 as it expects one argument for setting
	       the type of the PHY. Possible values are 0 (1.1 and 2.0),
	       1 (3.0)


Optional Properties:
- clocks : phandle + clock specifier for the phy clocks
- clock-names: string, clock name
- ipp: Invert Port Power
- ioc: Invert Over Current detection
- has_xhci: Contains an optional 3.0 PHY
- device: PHY Device mode. Possible values are: 0 (Host), 1 (Device)
          or 2 (DRD)



Example:

usbphy_0: usb-phy@f0470200 {
	reg = <0xf0470200 0xb8>,
		<0xf0471940 0x6c0>;
	#address-cells = <1>;
	#size-cells = <1>;
	compatible = "brcm,brcmstb-usb-phy";
	ioc = <1>;
	ipp = <1>;
	#phy-cells = <1>;
	ranges;
	has_xhci;
	clocks = <&sw_usb20>;
	clock-names = "sw_usb";
};
```

## Documentation/devicetree/bindings/phy/brcmstb-sata-phy.txt
```
* Broadcom STB AHCI SATA PHY (phy-brcmstb-sata)

Required properties:
- compatible: "brcm,brcmstb-sata-phy"
- reg: address and length of the register
- address-cells: should be 1
- size-cells: should be 0
- phy-cells: from the generic PHY bindings, must be 1
- ssc-enable: enabling SSC on port

Sub-nodes:
Each PHY should be represented as a sub-node.

Sub-nodes required properties:
- reg: the PHY number

Example:
	sata_phy0: phy@1800000 {
		compatible = "brcm,brcmstb-phy";
		reg = <0x180000 0x1000>;
		#address-cells = <1>;
		#size-cells = <0>;
		#phy-cells = <1>;
		status = "disabled";

		sata-phy@0 {
			reg = <0>;
		};

		sata-phy@1 {
			reg = <1>;
		};
	};
```
